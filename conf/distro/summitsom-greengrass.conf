## conf/distro/summitsom-greengrass.conf
```bitbake
require conf/distro/summitsom-cmd-secure.conf

DISTRO = "summitsom-greengrass"
DISTRO_NAME = "Summit SOM Greengrass Distro"

VIRTUAL-RUNTIME_init_manager = "systemd"
VIRTUAL-RUNTIME_initscripts = ""

PACKAGECONFIG:pn-greengrass-bin = "fleetprovisioning pkcs11"
```
